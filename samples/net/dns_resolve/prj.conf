## prj.conf
```kconfig
CONFIG_NETWORKING=y
CONFIG_NET_UDP=y
CONFIG_RANDOM_GENERATOR=y
CONFIG_TEST_RANDOM_GENERATOR=y
CONFIG_INIT_STACKS=y
CONFIG_NET_PKT_RX_COUNT=10
CONFIG_NET_PKT_TX_COUNT=10
CONFIG_NET_BUF_RX_COUNT=10
CONFIG_NET_BUF_TX_COUNT=10

CONFIG_NET_IF_UNICAST_IPV6_ADDR_COUNT=3
CONFIG_NET_IF_MCAST_IPV6_ADDR_COUNT=5

CONFIG_NET_LOG=y
CONFIG_SYS_LOG=y
CONFIG_SYS_LOG_NET_LEVEL=1
CONFIG_SYS_LOG_SHOW_COLOR=y
CONFIG_NET_DEBUG_NET_PKT=y
CONFIG_NET_DEBUG_DNS_RESOLVE=y
#CONFIG_NET_DEBUG_CONTEXT=y
#CONFIG_NET_DEBUG_CORE=y
#CONFIG_NET_DEBUG_IF=y
#CONFIG_NET_DEBUG_IPV4=y
#CONFIG_NET_DEBUG_IPV6=y
#CONFIG_NET_DEBUG_UDP=y
#CONFIG_NET_DEBUG_DHCPV4=y
#CONFIG_NET_DEBUG_L2_ETHERNET=y

CONFIG_NET_IPV6=y
CONFIG_NET_IPV4=y
CONFIG_NET_DHCPV4=n

# Enable the DNS resolver
CONFIG_DNS_RESOLVER=y
# Enable additional buffers
CONFIG_DNS_RESOLVER_ADDITIONAL_BUF_CTR=5
# Enable additional queries
CONFIG_DNS_RESOLVER_ADDITIONAL_QUERIES=2
# Enable mDNS support
CONFIG_MDNS_RESOLVER=y

CONFIG_DNS_RESOLVER_MAX_SERVERS=2
CONFIG_DNS_SERVER_IP_ADDRESSES=y
CONFIG_DNS_NUM_CONCUR_QUERIES=5

# Use local dnsmasq server for testing
CONFIG_DNS_SERVER1="[2001:db8::2]:15353"
CONFIG_DNS_SERVER2="192.0.2.2:15353"

# Google DNS IPv4 and IPv6 servers
#CONFIG_DNS_SERVER1="8.8.8.8"
#CONFIG_DNS_SERVER2="2001:4860:4860::8888"

# Router is needed when resolving using external DNS servers
CONFIG_NET_APP_NEED_IPV6_ROUTER=n

CONFIG_NET_MGMT=y
CONFIG_NET_MGMT_EVENT=y

CONFIG_NET_SHELL=y

CONFIG_NET_APP_SETTINGS=y
CONFIG_NET_APP_NEED_IPV6=y
CONFIG_NET_APP_NEED_IPV4=y
CONFIG_NET_APP_MY_IPV6_ADDR="2001:db8::1"
CONFIG_NET_APP_PEER_IPV6_ADDR="2001:db8::2"
CONFIG_NET_APP_MY_IPV4_ADDR="192.0.2.1"
CONFIG_NET_APP_PEER_IPV4_ADDR="192.0.2.2"

CONFIG_MAIN_STACK_SIZE=1504
```

## src/main.c
```c
/*
 * Copyright (c) 2017 Intel Corporation.
 *
 * SPDX-License-Identifier: Apache-2.0
 */

#if 1
#define SYS_LOG_DOMAIN "dns-fuzz"
#define NET_SYS_LOG_LEVEL SYS_LOG_LEVEL_DEBUG
#define NET_LOG_ENABLED 1
#endif

#include <zephyr.h>
#include <linker/sections.h>
#include <errno.h>
#include <stdio.h>

#include <net/net_core.h>
#include <net/net_if.h>
#include <net/net_mgmt.h>

#include "x_dns.h"

static void query_success(struct x_dns_ctx *d);
static void query_failure(struct x_dns_ctx *d);

static void query_success(struct x_dns_ctx *d) {
	NET_INFO("In query_success: %s", d->query);
	x_dns_lookup(d->dns, d->query, query_success, query_failure);
}

static void query_failure(struct x_dns_ctx *d) {
	NET_INFO("In query_failure: %s", d->query);
	x_dns_lookup(d->dns, d->query, query_success, query_failure);
}

static void setup_ipv4(struct net_if *iface)
{
	char hr_addr[NET_IPV4_ADDR_LEN];
	struct in_addr addr;

	struct x_dns dns;

	if (net_addr_pton(AF_INET, CONFIG_NET_APP_MY_IPV4_ADDR, &addr)) {
		NET_ERR("Invalid address: %s", CONFIG_NET_APP_MY_IPV4_ADDR);
		return;
	}

	net_if_ipv4_addr_add(iface, &addr, NET_ADDR_MANUAL, 0);

	NET_INFO("IPv4 address: %s",
		 net_addr_ntop(AF_INET, &addr, hr_addr, NET_IPV4_ADDR_LEN));

	x_dns_init(&dns, NULL);
	x_dns_lookup(&dns, "www.zephyrproject.org", query_success,
		     query_failure);
}

void main(void)
{
	struct net_if *iface = net_if_get_default();

	NET_INFO("Starting DNS resolve fuzzing client");

	setup_ipv4(iface);
}
```

## src/x_dns.c
```c
/** @file
 * @brief DNS API
 *
 * An API for applications to do DNS query.
 */

/*
 * Copyright (c) 2017 Intel Corporation
 *
 * SPDX-License-Identifier: Apache-2.0
 */

#if 1
#define SYS_LOG_DOMAIN "dns-fuzz"
#define NET_SYS_LOG_LEVEL SYS_LOG_LEVEL_DEBUG
#define NET_LOG_ENABLED 1
#endif

#include <zephyr.h>
#include <linker/sections.h>
#include <errno.h>
#include <stdio.h>

#include <net/net_core.h>
#include <net/net_if.h>
#include <net/net_mgmt.h>

#include <zephyr/types.h>
#include <string.h>

#include "x_dns.h"

static struct x_dns_ctx *x_dns_new_ctx(struct x_dns *d);
static void x_dns_resolve(struct k_work *work);
static void x_dns_reject(struct k_work *work);
static void x_dns_default_callback(enum dns_resolve_status status,
		   struct dns_addrinfo *info,
		   void *user_data);

struct x_dns *x_dns_init(struct x_dns *d, x_dns_result_cb callback)
{
	d->callback = callback ? callback : x_dns_default_callback;
	d->timeout = DNS_TIMEOUT;
	return d;
}

struct x_dns_ctx *x_dns_ctx_init(struct x_dns_ctx *d, struct x_dns *dns,
				 const char *query, x_dns_callback resolve,
				 x_dns_callback reject)
{
	d->dns = dns;
	d->query = query;
	d->resolve = resolve;
	d->reject = reject;
#if !defined(CONFIG_NET_IPV4) && !defined(CONFIG_NET_IPV6)
#error "You need to enable IPv4 or IPv6 to use DNS!"
#elif defined(CONFIG_NET_IPV4)
	d->query_type = DNS_QUERY_TYPE_AAAA;
#else
	d->query_type = DNS_QUERY_TYPE_A;
#endif
	return d;
}

void x_dns_lookup(struct x_dns *d, const char *query, x_dns_callback resolve,
		  x_dns_callback reject)
{
	int ret;
	struct x_dns_ctx *ctx = x_dns_new_ctx(d);
	if (!ctx) {
		NET_ERR("FAIL: Cannot create dns reslove context");
		return;
	}

	x_dns_ctx_init(ctx, d, query, resolve, reject);

	NET_DBG("DNS query: %s", ctx->query);
	ret = dns_get_addr_info(ctx->query,
				ctx->query_type,
				&ctx->id,
				d->callback,
				(void *)ctx,
				d->timeout);
	if (ret < 0) {
		NET_ERR("FAIL: Cannot resolve address (%d)", ret);
		return;
	}

	NET_DBG("DNS id %u", ctx->id);
}

static struct x_dns_ctx *x_dns_new_ctx(struct x_dns *d) {
	return &d->ctx_pool[0];
}

static void x_dns_resolve(struct k_work *work) {
	struct x_dns_ctx *ctx = CONTAINER_OF(work, struct x_dns_ctx, work);
	if (!ctx) {
		NET_ERR("FAIL: No resolve for DNS query of: %s", ctx->query);
		return;
	}

	NET_DBG("resolve ctx: %s", ctx->query);
	ctx->resolve(ctx);
}

static void x_dns_reject(struct k_work *work) {
	struct x_dns_ctx *ctx = CONTAINER_OF(work, struct x_dns_ctx, work);
	if (!ctx) {
		NET_ERR("FAIL: No reject for DNS query of: %s", ctx->query);
		return;
	}

	NET_DBG("reject ctx: %s", ctx->query);
	ctx->reject(ctx);
}

static void x_dns_default_callback(enum dns_resolve_status status,
		   struct dns_addrinfo *info,
		   void *user_data)
{
	char hr_addr[NET_IPV6_ADDR_LEN];
	char *hr_family;
	void *addr = NULL;
	struct x_dns_ctx *d = (struct x_dns_ctx *)user_data;

	switch (status) {
	case DNS_EAI_CANCELED:
		NET_INFO("DNS query was canceled");
		goto x_dns_default_callback_reject;
	case DNS_EAI_FAIL:
		NET_INFO("DNS resolve failed");
		goto x_dns_default_callback_reject;
	case DNS_EAI_NODATA:
		NET_INFO("Cannot resolve address");
		goto x_dns_default_callback_reject;
	case DNS_EAI_ALLDONE:
		NET_INFO("DNS resolving finished");
		goto x_dns_default_callback_reject;
	case DNS_EAI_INPROGRESS:
		break;
	default:
		NET_INFO("DNS resolving error (%d)", status);
		goto x_dns_default_callback_reject;
	}

	if (!info) {
		goto x_dns_default_callback_reject;
	}

	if (info->ai_family == AF_INET) {
		hr_family = "IPv4";
		memcpy(&d->addr, &net_sin(&info->ai_addr)->sin_addr,
		       sizeof(d->addr));
	} else if (info->ai_family == AF_INET6) {
		hr_family = "IPv6";
		memcpy(&d->addr, &net_sin6(&info->ai_addr)->sin6_addr,
		       sizeof(d->addr));
	} else {
		NET_ERR("Invalid IP address family %d", info->ai_family);
		goto x_dns_default_callback_reject;
	}

	NET_INFO("%s %s address: %s", d->query, hr_family,
		 net_addr_ntop(info->ai_family, addr,
			       hr_addr, sizeof(hr_addr)));

	k_delayed_work_init(&d->work, x_dns_resolve);
	goto x_dns_default_callback_return;

x_dns_default_callback_reject:
	k_delayed_work_init(&d->work, x_dns_reject);

x_dns_default_callback_return:
	k_delayed_work_submit(&d->work, 0);
}
```

## src/x_dns.h
```c
/** @file
 * @brief DNS resolving library
 *
 * An API for applications to resolve a DNS name.
 */

/*
 * Copyright (c) 2017 Intel Corporation
 *
 * SPDX-License-Identifier: Apache-2.0
 */

#ifndef _X_DNS_H
#define _X_DNS_H

#include <net/dns_resolve.h>

#ifdef __cplusplus
extern "C" {
#endif

#ifndef DNS_TIMEOUT
#define DNS_TIMEOUT K_SECONDS(2)
#endif

typedef void (*x_dns_result_cb)(enum dns_resolve_status status,
			 struct dns_addrinfo *info,
			 void *user_data);

struct x_dns;
struct x_dns_ctx;

typedef void (*x_dns_callback)(struct x_dns_ctx *);

struct x_dns_ctx
{
	u16_t id;
	struct k_delayed_work work;
	struct x_dns *dns;
	enum dns_query_type query_type;
	const char *query;
	struct sockaddr addr;
	x_dns_callback resolve;
	x_dns_callback reject;
};

struct x_dns
{
	x_dns_result_cb callback;
	s32_t timeout;
	void *data;
	struct x_dns_ctx ctx_pool[1];
};

struct x_dns *x_dns_init(struct x_dns *d, x_dns_result_cb callback);
struct x_dns_ctx *x_dns_ctx_init(struct x_dns_ctx *d, struct x_dns *dns,
				 const char *query, x_dns_callback resolve,
				 x_dns_callback reject);
void x_dns_lookup(struct x_dns *d, const char *query, x_dns_callback resolve,
		  x_dns_callback reject);

#ifdef __cplusplus
}
#endif

#endif /* _X_DNS_H */
```
